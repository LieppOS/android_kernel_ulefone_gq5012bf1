## drivers/chino-e/hwinfo/Kconfig
```kconfig
#
# OEM device bootinfo configuration
#

config OEM_DEVINFO
    tristate "device boot info"
    help
	Say Y here if you want to enable device boot info.
	If unsure, say N.

config OEM_BOOTINFO
    tristate "bootinfo"
    help
	Say Y here if you want to enable bootinfo.
	If unsure, say N.

config OEM_BOARDID
    tristate "boardid"
    help
	Say Y here if you want to enable boardid.
	If unsure, say N.

config OEM_HWINFO
    tristate "hwinfo"
    help
	Say Y here if you want to enable hwinfo.
	If unsure, say N.

config OEM_CAMINFO
    bool "camera identity storage"
    help
	  Exports the camera module id / depth-camera serial arrays that the
	  ODM bootinfo driver provides to the camera stack.  Split out because
	  the full bootinfo driver needs ODM charger/typec/haptic providers that
	  are not part of this source tree.
```

## drivers/input/fingerprint/Kconfig
```kconfig
config MTK_FINGERPRINT
	tristate "Mediatek Fingerprint"
	default y
	help
	Fingerprint mtk driver enable/disable in the kernel.
	Say Y here if you want to use mediatek fingerprint driver,
	fingerprint driver will support fingerprint function in REE,
	it supports Goodix's

config GOODIX_FINGERPRINT
	tristate "generic goodix fingerprint driver"
	default y
	help
	add support for goodix fingerprint driver.

source "$(KCONFIG_EXT_PREFIX)drivers/input/fingerprint/goodix/Kconfig"


config YFT_FINGERPRINT
	tristate "YFT fingerprint pinctrl/power glue"
	depends on OF
	help
	  YFT fingerprint GPIO, pinctrl and power sequencing glue used by the
	  MicroArray fingerprint driver on MT6878 devices.  Exports the
	  yft_finger_* helper API consumed by the sensor driver.

config MICROARRAY_FP_TEE
	tristate "MicroArray fingerprint sensor over TrustKernel TEE"
	depends on SPI
	select YFT_FINGERPRINT if OF
	help
	  MicroArray v4.0.06 fingerprint sensor driver.  SPI transfers are
	  routed through the TrustKernel tee_spi_transfer() proxy; power,
	  reset and IRQ lines are handled by the YFT glue.
```

## drivers/media/platform/Kconfig
```kconfig
# SPDX-License-Identifier: GPL-2.0-only
#
# Platform drivers
#	Most drivers here are currently for webcam support

menuconfig MEDIA_PLATFORM_DRIVERS
	bool "Media platform devices"
	default "y"
	help
	  Say Y here to enable support for platform-specific media drivers.

if MEDIA_PLATFORM_DRIVERS

config V4L_PLATFORM_DRIVERS
	bool "V4L platform devices"
	help
	  Say Y here to enable support for platform-specific V4L drivers.

config SDR_PLATFORM_DRIVERS
	bool "SDR platform devices"
	depends on MEDIA_SDR_SUPPORT
	help
	  Say Y here to enable support for platform-specific SDR Drivers.

config DVB_PLATFORM_DRIVERS
	bool "DVB platform devices"
	depends on MEDIA_DIGITAL_TV_SUPPORT
	help
	  Say Y here to enable support for platform-specific Digital TV drivers.

config V4L_MEM2MEM_DRIVERS
	bool "Memory-to-memory multimedia devices"
	depends on VIDEO_DEV
	help
	  Say Y here to enable selecting drivers for V4L devices that
	  use system memory for both source and destination buffers, as opposed
	  to capture and output drivers, which use memory buffers for just
	  one of those.

# Ancillary drivers

config VIDEO_MEM2MEM_DEINTERLACE
	tristate "Deinterlace support"
	depends on V4L_MEM2MEM_DRIVERS
	depends on VIDEO_DEV
	depends on HAS_DMA
	select VIDEOBUF2_DMA_CONTIG
	select V4L2_MEM2MEM_DEV
	help
	    Generic deinterlacing V4L2 driver.

config VIDEO_MUX
	tristate "Video Multiplexer"
	depends on V4L_PLATFORM_DRIVERS
	select MULTIPLEXER
	depends on VIDEO_DEV && OF
	select MEDIA_CONTROLLER
	select VIDEO_V4L2_SUBDEV_API
	select REGMAP
	select V4L2_FWNODE
	help
	  This driver provides support for N:1 video bus multiplexers.

# Platform drivers - Please keep it alphabetically sorted
source "drivers/media/platform/allegro-dvt/Kconfig"
source "drivers/media/platform/amlogic/Kconfig"
source "drivers/media/platform/amphion/Kconfig"
source "drivers/media/platform/aspeed/Kconfig"
source "drivers/media/platform/atmel/Kconfig"
source "drivers/media/platform/cadence/Kconfig"
source "drivers/media/platform/chips-media/Kconfig"
source "drivers/media/platform/intel/Kconfig"
source "drivers/media/platform/marvell/Kconfig"
source "drivers/media/platform/mediatek/Kconfig"
source "drivers/media/platform/nvidia/Kconfig"
source "drivers/media/platform/nxp/Kconfig"
source "drivers/media/platform/qcom/Kconfig"
source "drivers/media/platform/renesas/Kconfig"
source "drivers/media/platform/rockchip/Kconfig"
source "drivers/media/platform/samsung/Kconfig"
source "drivers/media/platform/st/Kconfig"
source "drivers/media/platform/sunxi/Kconfig"
source "drivers/media/platform/ti/Kconfig"
source "drivers/media/platform/verisilicon/Kconfig"
source "drivers/media/platform/via/Kconfig"
source "drivers/media/platform/xilinx/Kconfig"

endif # MEDIA_PLATFORM_DRIVERS

# ---- MediaTek/vendor entries merged from kernel_device_modules ----
config DEVICE_MODULES_VIDEO_MEDIATEK_JPEG
	tristate "Mediatek JPEG Codec driver"
	depends on MTK_IOMMU_V1 || DEVICE_MODULES_MTK_IOMMU || COMPILE_TEST
	depends on VIDEO_DEV
	depends on ARCH_MEDIATEK || COMPILE_TEST
	depends on DEVICE_MODULES_MTK_SMI || (COMPILE_TEST && DEVICE_MODULES_MTK_SMI=n)
	select VIDEOBUF2_DMA_CONTIG
	select V4L2_MEM2MEM_DEV
	help
	  Mediatek jpeg codec driver provides HW capability to decode
	  JPEG format

	  To compile this driver as a module, choose M here: the
	  module will be called mtk-jpeg

source "$(KCONFIG_EXT_PREFIX)drivers/media/platform/mtk-vcodec/Kconfig"
source "$(KCONFIG_EXT_PREFIX)drivers/media/platform/mtk-isp/Kconfig"
source "$(KCONFIG_EXT_PREFIX)drivers/media/platform/mtk-aie/Kconfig"
source "$(KCONFIG_EXT_PREFIX)drivers/media/platform/mtk-dpe/Kconfig"


config DEVICE_MODULES_VIDEO_MEDIATEK_VCODEC
	tristate "Mediatek Video Codec driver"
	depends on DEVICE_MODULES_MTK_IOMMU || COMPILE_TEST
	depends on VIDEO_DEV
	depends on ARCH_MEDIATEK || COMPILE_TEST
	depends on VIDEO_MEDIATEK_VPU || MTK_SCP || MTK_TINYSYS_VCP_SUPPORT || VIDEO_MEDIATEK_VCU
	# The two following lines ensure we have the same state ("m" or "y") as
	# our dependencies, to avoid missing symbols during link.
	depends on VIDEO_MEDIATEK_VPU || !VIDEO_MEDIATEK_VPU
	depends on MTK_SCP || !MTK_SCP
	depends on MTK_TINYSYS_VCP_SUPPORT || !MTK_TINYSYS_VCP_SUPPORT
	depends on DEVICE_MODULES_MTK_SMI || (COMPILE_TEST && DEVICE_MODULES_MTK_SMI=n)
	select VIDEOBUF2_DMA_CONTIG
	select V4L2_MEM2MEM_DEV
	select VB2_MEDIATEK_DMA_CONTIG
	select DEVICE_MODULES_VIDEO_MEDIATEK_VCODEC_VPU if VIDEO_MEDIATEK_VPU
	select DEVICE_MODULES_VIDEO_MEDIATEK_VCODEC_SCP if MTK_SCP
	help
	  Mediatek video codec driver provides HW capability to
	  encode and decode in a range of video formats on MT8173
	  and MT8183.

	  Note that support for MT8173 requires VIDEO_MEDIATEK_VPU to
	  also be selected. Support for MT8183 depends on MTK_SCP.

	  To compile this driver as modules, choose M here: the
	  modules will be called mtk-vcodec-dec and mtk-vcodec-enc.


config VIDEO_MEDIATEK_VCU
	tristate "Mediatek VCU driver"
	help
	  Mediatek video kernel driver for user space vpud.

	  The driver support communicate with user space video driver vpud
	  and allocate, free memory, etc.

	  To compile this driver as modules, choose M here: the
	  modules will be called mtk-vcu.


config MTK_TINYSYS_VCP_SUPPORT
	tristate "Mediatek VCP driver"
	help
	  Mediatek video kernel driver for micro-P.

	  The driver support control and communicate vcp and allocate,
	  free memory, etc.

	  To compile this driver as modules, choose M here: the
	  modules will be called vcp and vcp_status.


config DEVICE_MODULES_VIDEO_MEDIATEK_VCODEC_VPU
	bool


config DEVICE_MODULES_VIDEO_MEDIATEK_VCODEC_SCP
	bool


config MTK_CAMSYS_VEND_HOOK
	bool "Support Mediatek CAMSYS vnedor hook"
	depends on VIDEO_DEV
	help
	  If it is enabled, CAMSYS will have vendor hook
```

## drivers/media/platform/mtk-isp/Kconfig
```kconfig
config VIDEO_MTK_ISP_COMMON
	bool "Mediatek camera subsystem driver"
	select DMA_SHARED_BUFFER
	select VIDEO_V4L2_SUBDEV_API
	select VIDEOBUF2_DMA_CONTIG
	select VIDEOBUF2_CORE
	select VIDEOBUF2_V4L2
	select VIDEOBUF2_MEMOPS
	select MEDIA_CONTROLLER
	select MEDIA_CONTROLLER_REQUEST_API

	help
	    Generic helpers for Mediatek SoCs ISP drivers. Mediatek
	    SoCs ISP drivers have similar image handling flow. For
	    example, Mediatek's ISP IPs may accept multiple input
	    buffers of a frame and generate multiple output buffers
	    of different format, size and effect. The helpers
	    provide the functions to create the common flow.

	    This feature will be removed in the upstream version
	    of Mediatek SoCs ISP drivers. It added some
	    abstraction implementing V4L2 and VB2 ops using
	    MTK-specific ops, which is not a discouraged pattern
	    of V4L2 drivers.

	    Choose y if you have drivers using the common utilities.

config VIDEO_MTK_ISP_CAMSYS
	tristate "Mediatek camsys processing function"
	select V4L2_FWNODE

	help
	    Camsys driver controls 3A (autofocus, exposure,
	    and white balance) with tuning feature and output
	    the first capture image buffer in Mediatek's camera system.

	    This driver also provides a mipi-csi2 host driver used as a
	    interface to connect camera with Mediatek's SOCs. It is able
	    to handle multiple cameras
	    simultaneously.

	    Choose y if you want to use Mediatek SoCs to create image
	    capture application such as video recording and still image
	    capture.

config VIDEO_MTK_ISP_CAMSYS_DUBUG
	tristate "Mediatek camsys debug function"
	help
	    Camsys driver controls 3A (autofocus, exposure,
	    and white balance) with tuning feature and output
	    the first capture image buffer in Mediatek's camera system.
	    This configuration provides more debug information.

config VIDEO_MTK_ISP_HCP
	tristate "Mediatek hcp processing function"
	help
	    HCP driver acts a message protocol between imgsys driver and
	    userspace daemon. messages can include enqueue event, dequeue
	    events, and other notification events that are needed for a
	    working camera session.

config VIDEO_MTK_ISP_AOV
	tristate "Mediatek aov processing function"
	help
	    AOV driver acts a message protocol between aov scp driver and
	    userspace process. messages can include init, deint and aov
	    notification events. The operation modes include normal detect,
	    debug and bit-true dump mode.

config VIDEO_MTK_ISP_IMGSYS
	tristate "Mediatek imgsys processing function"
	help
	    imgsys driver controls post-processing on the streaming images
	    and/or statistics for better image qualities
	    such as noise reduction, edge enhencement,
	    and motion estimation, etc.

config VIDEO_MTK_ISP_IPESYS
	tristate "Mediatek ipesys processing function"
	help
	    ipesys driver is a varaint of imgsys driver
	    which process the images to generate useful statistics
	    for isp pipeline image computation such
	    as motion estimation.

config VIDEO_MTK_ISP_IMGSYS_7S
	tristate "Mediatek imgsys processing function"
	help
	    imgsys driver controls post-processing on the streaming images
	    and/or statistics for better image qualities
	    such as noise reduction, edge enhencement,
	    and motion estimation, etc.

config VIDEO_MTK_ISP_IMGSYS_CMDQ
	tristate "Mediatek imgsys cmdq processing function"
	help
	    imgsys cmdq driver acts a message protocol between imgsys
	    driver and gce driver. messages can include R/W registers,
	    wait gce events, and notification that are needed for a
	    working camera session.

config VIDEO_MTK_ISP_IMGSYS_7SP
	tristate "Mediatek imgsys processing function"
	help
	    imgsys driver controls post-processing on the streaming images
	    and/or statistics for better image qualities
	    such as noise reduction, edge enhencement,
	    and motion estimation, etc.

# The external mtkcam camsys source uses one VIDEO_MTK_ISP_CAMSYS symbol for
# three mutually exclusive provider families.  Keep separate symbols here and
# let mtkcam/camsys/Kbuild apply the deterministic priority below.  GQ5012BF1
# stock ships mtk-cam-isp7sp.ko only, hence the ISP7SP default.
config MTK_CAMERA_CAMSYS_7_1
	bool "ISP7.1 camsys (mtk-cam-isp)"
	default n

config MTK_CAMERA_CAMSYS_7S
	bool "ISP7S camsys (mtk-cam-isp7s)"
	default n

config MTK_CAMERA_CAMSYS_7SP
	bool "ISP7SP camsys (mtk-cam-isp7sp)"
	default y

config MTK_C2PS
	tristate "Support MTK Camera Power Performance Sceduling (C2PS) mechanism mechanism"
	help
		C2PS driver supports Camera Power Performance Sceduling mechanism,
		which monitors critical tasks and
		sets suitable uclamp value for these tasks.
		C2PS ioctl module is also set by this config.

config LIEPPOS_EXTERNAL_IMGSYS
	bool "Use the external mtkcam imgsys/HCP providers"
	default n
	help
	  Opt-in build ownership selection for the GQ5012BF1 Android 17 profile.
	  The unified engine must build the stock-compatible external imgsys and
	  mtk-hcp trees against this kernel. This suppresses only their older
	  in-tree copies; it does not remove camera functionality or alter the
	  VIDEO_MTK_ISP_* API selections used by the external Kbuilds.
```

## drivers/misc/mediatek/performance/lieppos14/Kconfig
```kconfig
# SPDX-License-Identifier: GPL-2.0
menuconfig LIEPPOS_PERFORMANCE
	tristate "LieppOS MediaTek frame-performance framework (experimental)"
	depends on ARM64 && CPU_FREQ && SMP && PROC_FS && SYSFS
	depends on UCLAMP_TASK && ANDROID_VENDOR_HOOKS
	depends on m
	select MTK_FPSGO_V3
	select MTK_PERFORMANCE_MODULE
	help
	  Build the authenticated MediaTek ioctl, PowerHAL/ADPF, FPSGO
	  base/composer/FBT/FSTB/XGF/GBE and reconstructed private algorithms.
	  Source-generated modversions and target-specific builds are required.
	  Generic GKI uses frequency-proportional FBT, per-task util clamps and
	  frequency QoS; it does not emulate MediaTek scheduler VIP/LS/group
	  state, nonlinear OPP capacity, GED, DRM or DVFSRC hardware services.
	  Enabling those requires the real matching platform providers.
	  This source group is experimental/HOLD, not accepted for deployment.
	  The framework and algorithm/service modules deliberately disallow unload
	  until the donor's raw callback publications have complete rundown.

# Existing donor Kbuild selectors. Do not include the donor's broad performance
# menu here: its unrelated touch boost/load tracking profiles are not enabled.
config MTK_FPSGO_V3
	tristate

config MTK_PERFORMANCE_MODULE
	tristate
```
