## drivers/misc/mediatek/performance/lieppos14/Kconfig.targetc
```kconfig
# SPDX-License-Identifier: GPL-2.0
# Included ONLY by the pinned native performance Kconfig overlay. Native
# MTK_FPSGO_V3, MTK_PERFORMANCE_MODULE and MTK_C2PS already have real owners.
# Do not include the standalone hidden-symbol Kconfig in the device tree.
menuconfig LIEPPOS_PERFORMANCE
	tristate "LieppOS maintained FPSGO cohort (experimental, permanent lifetime)"
	depends on ARM64 && SMP && CPU_FREQ && PROC_FS && SYSFS
	depends on UCLAMP_TASK && ANDROID_VENDOR_HOOKS
	depends on MTK_SCHEDULER && NONLINEAR_FREQ_CTL && MTK_OPP_CAP_INFO
	depends on MTK_PERF_CTRL_LEASE && MTK_SCHED_GROUP_AWARE && MTK_CPUQOS_V3
	depends on m
	select MTK_FPSGO_V3
	select MTK_PERFORMANCE_MODULE
	help
	  Replace the complete native FPSGO/ioctl/PowerHAL cohort, not selected
	  translation units or foreign headers. Existing touch boost, FRS,
	  game and load tracker source owners remain intact. Android restricted
	  hooks cannot be unregistered: this framework pins its module after
	  commit and is not unloadable. Experimental/HOLD; no hardware proof.

config LIEPPOS_PERFORMANCE_TARGET_C
	bool
	default y if LIEPPOS_PERFORMANCE != n

config MTK_PERF_CTRL_LEASE
	bool "Native sugov, task-field and scheduler clamp leases"
	depends on NONLINEAR_FREQ_CTL && MTK_OPP_CAP_INFO && MTK_SCHEDULER
	depends on UCLAMP_TASK
	default n
	help
	  Requires reviewed native-control-lease.patch AND
	  scheduler-uclamp-lease.patch in the pinned kernel.
	  Native legacy setters atomically preempt temporary sugov and task
	  VIP/hint leases. Stable task references, not cached PID numbers,
	  identify task leases. A displaced client cannot restore over a newer
	  writer. The scheduler owns its clamp transaction under pi/rq locks;
	  ordinary sched_setattr writers revoke even an identical-value request.
	  No stub provider or generic fallback exists.

config LIEPPOS_C2PS
	tristate "LieppOS maintained native C2PS cohort (experimental/HOLD)"
	depends on LIEPPOS_PERFORMANCE && MTK_C2PS
	depends on NONLINEAR_FREQ_CTL && MTK_SCHEDULER && MTK_PERF_CTRL_LEASE
	depends on EXPERT && m
	default n
	help
	  Build authentic MT6878 C2PS and its matching ioctl source as one
	  cohort. Session/task/global-control ownership and real device-kernel
	  validation remain incomplete. Do not enable a competing camera-tree
	  C2PS implementation. This provider has permanent callback lifetime;
	  it is not a deployable or unload-safe subsystem certification.
```

## drivers/misc/mediatek/sensor/2.0/Kconfig
```kconfig
# SPDX-License-Identifier: GPL-2.0

source "$(KCONFIG_EXT_PREFIX)drivers/misc/mediatek/sensor/2.0/mtk_nanohub/Kconfig"
source "$(KCONFIG_EXT_PREFIX)drivers/misc/mediatek/sensor/2.0/sensorhub/Kconfig"
source "$(KCONFIG_EXT_PREFIX)drivers/misc/mediatek/sensor/2.0/test/Kconfig"
source "$(KCONFIG_EXT_PREFIX)drivers/misc/mediatek/sensor/2.0/lsm6dsm_secondary/Kconfig"

config YFT_DEVINFO
	tristate "Ulefone/YFT device information provider (yft_devinfo)"
	default n
	help
	  YFT (Ulefone) device-information provider. It is the shared provider
	  consumed by the touch, sensor, fuel-gauge and camera modules on the
	  GQ5012BF1 platform (hf_manager, focaltech, hynitron, sh366003_fg, ...).
	  Source reconstructed by LieppOS from the stock vendor_dlkm binary.
```

## drivers/misc/mediatek/tiny_lcd/Kconfig
```kconfig
config MTK_TINY_LCD
	tristate "MediaTek tiny LCD (CO5300) support (Ulefone GQ5012BF1)"
	help
	  SPI-attached CO5300 tiny LCD panel used on the Ulefone GQ5012BF1.
	  Uses the YFT tinylcd device registry (yft_tinylcd_device_add/used).
	  Source reconstructed by LieppOS from the stock vendor_dlkm module
	  spi_tiny_co5300_lcd.ko.
```

## drivers/misc/mediatek/trusted_mem/Kconfig
```kconfig
# SPDX-License-Identifier: GPL-2.0
#
# Copyright (C) 2018 MediaTek Inc.
#

config MTK_PROT_MEM_SUPPORT
	bool "MTK Protect Memory Support"
	default y
	depends on MTK_GZ_KREE
	help
	  Enable the support of MediaTek protect memory driver.
	  This driver is in charge of protect memory region require/release
	  from SSMR and also the memory allocation/free requests from ION.
	  It is a proxy of MediaTek proprietary EL2 hypervisor for protect
	  memory management.
	  Say Y if you would like to enable this feature.
	  If unsure, say N.

config MTK_SECURE_MEM_SUPPORT
	bool "MTK SVP SECURE Memory Support"
	default y
	depends on TRUSTONIC_TEE_SUPPORT || MTK_TEE_GP_SUPPORT || MTK_GZ_KREE
	help
	  Enable the support of MediaTek SVP secure memory driver.
	  This driver is in charge of SVP secure memory region require/release
	  from SSMR and also the memory allocation/free requests from ION.
	  It is a proxy of TEE secure memory driver for SVP secure memory
	  management.
	  Say Y if you would like to enable this feature.
	  If unsure, say N.

config MTK_WFD_SMEM_SUPPORT
	bool "MTK WFD SECURE Memory Support"
	default y
	depends on MTK_SECURE_MEM_SUPPORT
	help
	  Enable the support of MediaTek WFD secure memory driver.
	  This driver is in charge of WFD secure memory region require/release
	  from SSMR and also the memory allocation/free requests from ION.
	  It is a proxy of TEE secure memory driver for WFD secure memory
	  management.
	  Say Y if you would like to enable this feature.
	  If unsure, say N.

config MTK_HAPP_MEM_SUPPORT
	bool "MTK MTEE Hypervisor App Memory Support"
	depends on MTK_GZ_KREE
	help
	  Enable the support of MediaTek MTEE EL2 app memory driver.
	  This driver is in charge of EL2 app memory region require/release
	  from SSMR and also the memory allocation/free requests from ION.
	  It is a proxy of MediaTek proprietary EL2 hypervisor for isolated
	  memory management.
	  Say Y if you would like to enable this feature.
	  If unsure, say N.

config MTK_SDSP_MEM_SUPPORT
	bool "MTK MTEE SDSP Firmware Memory Support"
	depends on MTK_GZ_KREE
	help
	  Enable the support of MediaTek MTEE SDSP firmware memory driver.
	  This driver is in charge of SDSP image memory region require/release
	  from SSMR and also the memory allocation/free requests from ION.
	  It is a proxy of MediaTek proprietary EL2 hypervisor for isolated
	  memory management.
	  Say Y if you would like to enable this feature.
	  If unsure, say N.

config MTK_SDSP_SHARED_MEM_SUPPORT
	bool "MTK SDSP Shared Memory Support"
	depends on MTK_GZ_KREE
	help
	  Enable the support of MediaTek SDSP shared memory driver.
	  This driver is in charge of SDSP shared memory region require/release
	  from SSMR and also the memory allocation/free requests from ION.
	  It is a proxy of MediaTek proprietary EL2 hypervisor or TEE secure
	  memory driver for isolated memory management.
	  Say Y if you would like to enable this feature.
	  If unsure, say N.

config ALLOC_TMEM_WITH_HIGH_FREQ
        bool "MTK Improve High Freq When Alloc Trusted mem"
        default y
        help
           Enable the support of reducing the costing time when trusted mem allocated.
           It can improve the cpu group freq when needed.
           This function is valid only at the tmem allocating starting
           and invalid at the end
           If unsure, say N.

choice
	prompt "MTK VPU/MTEE/MTEE Shared Memory Support"
	depends on MTK_SDSP_SHARED_MEM_SUPPORT
	default MTK_SDSP_SHARED_PERM_VPU_MTEE_TEE

config MTK_SDSP_SHARED_PERM_VPU_TEE
	bool "MTK SDSP Shared Memory Permssions for VPU/TEE"
	help
	  Enable the support of SDSP shared memory buffer to be shared
	  between VPU hardware and TEE.
	  Select if you would like to enable this feature.
	  If unsure, say N.

config MTK_SDSP_SHARED_PERM_MTEE_TEE
	bool "MTK SDSP Shared Memory Permssions for MTEE/TEE"
	help
	  Enable the support of SDSP shared memory buffer to be shared
	  between MTEE and TEE.
	  Select if you would like to enable this feature.
	  If unsure, say N.

config MTK_SDSP_SHARED_PERM_VPU_MTEE_TEE
	bool "MTK SDSP Shared Memory Permssions for VPU/MTEE/TEE"
	help
	  Enable the support of SDSP shared memory buffer to be shared
	  between VPU hardware, MTEE and TEE.
	  Select if you would like to enable this feature.
	  If unsure, say N.
endchoice

config MTK_MTEE_MULTI_CHUNK_SUPPORT
	bool "MTK MTEE Multiple Chunk Memory Support"
	depends on MTK_HAPP_MEM_SUPPORT || MTK_SDSP_MEM_SUPPORT || \
		   MTK_SDSP_SHARED_PERM_MTEE_TEE || \
		   MTK_SDSP_SHARED_PERM_VPU_MTEE_TEE
	help
	  Enable the support of MediaTek MTEE multiple chunks memory driver.
	  This driver is in charge of multi-chunk memory region require/release
	  from SSMR and also the memory allocation/free requests from ION.
	  It is a proxy of MTEE multi-chunk memory driver for isolated memory
	  management.
	  Say Y if you would like to enable this feature.
	  If unsure, say N.

config MTK_TRUSTED_MEMORY_SUBSYSTEM
	tristate "MTK Trusted Memory Subsystem Support"
	default m
	depends on MTK_PROT_MEM_SUPPORT || MTK_SECURE_MEM_SUPPORT || \
			   MTK_MTEE_MULTI_CHUNK_SUPPORT || MTK_GZ_KREE
	select CMA
	select DMA_CMA
	help
	  Enable the support of MediaTek trusted memory subsystem driver.
	  This driver provide a general subsystem layer for trusted peer memory
	  manager such as EL2 hypervisor or TEE. New type of trusted memory can
	  be registered to this subsystem easily.
	  Say Y if you would like to build it in kernel image.
	  Say M if you would like to build it as a kernel module.
	  If unsure, say N.

config TEST_MTK_TRUSTED_MEMORY
	tristate "MTK Trusted Memory UT SUITE"
	default n
	depends on MTK_TRUSTED_MEMORY_SUBSYSTEM
	help
	  This is a test module doing various nasty things like
	  open/close/alloc/free operation, It is useful for testing
	  trusted memory features.

config MTK_PROT_MEM_SSHEAP_V2
	bool "MTK Protect Memory ssheap v2 Support"
	default y
	help
	  Enable the support of MediaTek page based protect memory driver.
	  This driver provide a page-base solution from buddy system for protection
	  secure memory protection.
	  Say Y if you would like to enable this feature.
	  If unsure, say N.

config MTK_TRUSTED_MEM_FORCE_PLAIN
	bool "Build trusted_mem.ko (no-FFA variant) instead of tmem_ffa.ko"
	depends on MTK_TRUSTED_MEMORY_SUBSYSTEM
	default n
	help
	  Both modules export the same trusted_mem_* symbols, so only one can be
	  linked. The GQ5012BF1 vendor image ships tmem_ffa.ko; enable this only for
	  platforms without Arm FF-A.

config MTK_FFA_VENDOR_TRANSPORT
	tristate "MediaTek vendor Arm FF-A transport (ffa_v10.ko)"
	depends on ARM_FFA_TRANSPORT
	help
	  MediaTek's own copy of the Arm FF-A transport. It exports the same ffa_*
	  symbols as drivers/firmware/arm_ffa, so exactly one of the two may be
	  built. The stock GQ5012BF1 vendor image ships ffa_v10.ko; select this as
	  a module to match it ("y" would move the symbols into the kernel image).
```

## drivers/misc/mediatek/yft_usb/Kconfig
```kconfig
config MTK_YFT_TINY2C_USB
	tristate "YFT tiny-I2C USB accessory detector (Ulefone GQ5012BF1)"
	depends on I2C
	help
	  YFT tiny-I2C USB accessory detection driver used on the Ulefone
	  GQ5012BF1 (uses the yft_usb_flag registry). Source reconstructed by
	  LieppOS from the stock vendor_dlkm module yft_tiny2c_usb.ko.
```

## drivers/soc/mediatek/scheduler_ext/Kconfig
```kconfig
# SPDX-License-Identifier: GPL-2.0
config MTK_SCHEDULER_EXT
	tristate "MediaTek scheduler extension identity"
	help
	  The stock scheduler_ext module is an ABI-neutral metadata-only module.
	  It contains no scheduler hooks or exports.  Enable this only to
	  reproduce the shipped module identity.
```

## drivers/tee/Kconfig
```kconfig
# SPDX-License-Identifier: GPL-2.0-only
# Generic Trusted Execution Environment Configuration
menuconfig TEE
	tristate "Trusted Execution Environment support"
	depends on HAVE_ARM_SMCCC || COMPILE_TEST || CPU_SUP_AMD
	select CRYPTO
	select CRYPTO_SHA1
	select DMA_SHARED_BUFFER
	select GENERIC_ALLOCATOR
	help
	  This implements a generic interface towards a Trusted Execution
	  Environment (TEE).

if TEE

source "drivers/tee/optee/Kconfig"
source "drivers/tee/amdtee/Kconfig"

endif

# ---- MediaTek/vendor entries merged from kernel_device_modules ----
config MTK_TEE_GP_SUPPORT
	bool "Enable MTK GlobalPlatform support in TEE related modules"
	default n
	depends on (TRUSTONIC_TEE_SUPPORT) || (MICROTRUST_TEE_SUPPORT)
	help
	  GlobalPlatform defines common/consistent APIs and this option
	  enables TEE related modules to use GPAPIs. (depending on
	  Trustonic TEE Support or Microtrust TEE Support or Google Trusty
	  TEE or other 3rd-party TEE)

source "$(KCONFIG_EXT_PREFIX)drivers/tee/teeperf/Kconfig"
source "$(KCONFIG_EXT_PREFIX)drivers/tee/gud/Kconfig"
source "$(KCONFIG_EXT_PREFIX)drivers/tee/teei/Kconfig"
source "$(KCONFIG_EXT_PREFIX)drivers/tee/tkcore/Kconfig"
```

## drivers/ufs/Kconfig
```kconfig
# SPDX-License-Identifier: GPL-2.0-only
#
# UFS subsystem configuration
#

menuconfig SCSI_UFSHCD
	tristate "Universal Flash Storage Controller"
	depends on SCSI && SCSI_DMA
	select PM_DEVFREQ
	select DEVFREQ_GOV_SIMPLE_ONDEMAND
	select NLS
	help
	  Enables support for UFS (Universal Flash Storage) host controllers.
	  A UFS host controller is an electronic component that is able to
	  communicate with a UFS card. UFS host controllers occur in
	  smartphones, laptops, digital cameras and also in cars.
	  The kernel module will be called ufshcd.

	  To compile this driver as a module, choose M here and read
	  <file:Documentation/scsi/ufs.rst>.
	  However, do not compile this as a module if your root file system
	  (the one containing the directory /) is located on a UFS device.

if SCSI_UFSHCD

source "drivers/ufs/core/Kconfig"

source "drivers/ufs/host/Kconfig"

endif

# ---- MediaTek/vendor entries merged from kernel_device_modules ----
config DEVICE_MODULES_SCSI_UFS_MEDIATEK
	tristate "Mediatek specific hooks to UFS controller platform driver"
	depends on SCSI_UFSHCD_PLATFORM && ARCH_MEDIATEK
	select DEVICE_MODULES_PHY_MTK_UFS
	select DEVICE_MODULES_RESET_TI_SYSCON
	help
	  This selects the Mediatek specific additions to UFSHCD platform driver.
	  UFS host on Mediatek needs some vendor specific configuration before
	  accessing the hardware which includes PHY configuration and vendor
	  specific registers.

	  Select this if you have UFS controller on Mediatek chipset.

	  If unsure, say N.


config SCSI_UFS_MEDIATEK_DBG
	tristate "Debugging facility for MediaTek UFS platforms"
	depends on DEVICE_MODULES_SCSI_UFS_MEDIATEK
	help
	  This selects the debugging facility for Mediatek UFS platforms.
	  Provide UFS command history and connection to MediaTek Block IO
	  Tracer.

	  Select this if you want to enable above facilities.

	  If unsure, say N.

source "$(KCONFIG_EXT_PREFIX)drivers/ufs/vendor/Kconfig"


config MTK_UFS_DEBUG
	bool "Support Mediatek UFS upstreaming features"
	depends on SCSI_UFSHCD
	help
	  If it is enabled, all code sections that is under
	  upstream process or not pulled from the mainstream
	  are enabled.

	  If unsure, say N.


config MTK_UFS_DEBUG_BUILD
	bool "Support Mediatek UFS facilities in debug build only"
	depends on SCSI_UFSHCD
	help
	  This selects the debugging facility for Mediatek UFS platforms
	  existed in debug build only.

	  Select this if you want to enable above facilities.

	  If unsure, say N.
```
